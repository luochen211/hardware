/**
 * 实验3B：智慧农业板传感器（土壤湿度 + 光照 + 雨滴 + OLED）
 * ====================================================================
 * 硬件：智慧农业模块板（Smart_Agriculture_Module）
 *
 * 引脚（实训箱原理图 + ESP32 ADC通道映射）：
 *   土壤湿度(SOIL_ADC):  ADC1_CH6 = GPIO34
 *   光照(LIGHT_ADC):     ADC1_CH7 = GPIO35
 *   雨滴(RAIN_ADC):      ADC1_CH5 = GPIO33
 *   OLED(I2C):           SCL=GPIO19, SDA=GPIO18, 地址0x3C
 *
 * 注意：GPIO34/35是输入专用引脚，只能做ADC，无上拉/下拉
 *
 * 编译运行：
 *   idf.py set-target esp32
 *   idf.py build flash monitor
 */

#include <stdio.h>
#include <string.h>
#include "freertos/FreeRTOS.h"
#include "freertos/task.h"
#include "driver/gpio.h"
#include "driver/i2c.h"
#include "esp_adc/adc_oneshot.h"
#include "esp_err.h"
#include "esp_log.h"

static const char *TAG = "EXP3B";

#define STUDENT_ID   "2025xxxxxx"
#define STUDENT_NAME "张三"

/* --- ADC通道定义（ESP32 ADC1通道→GPIO映射）---
 * ADC1_CH5 = GPIO33（雨滴）
 * ADC1_CH6 = GPIO34（土壤湿度）
 * ADC1_CH7 = GPIO35（光照）
 */
#define SOIL_ADC_CHANNEL   ADC_CHANNEL_6   /* GPIO34 */
#define LIGHT_ADC_CHANNEL  ADC_CHANNEL_7   /* GPIO35 */
#define RAIN_ADC_CHANNEL   ADC_CHANNEL_5   /* GPIO33 */

/* --- I2C OLED --- */
#define I2C_MASTER_SCL_IO  GPIO_NUM_19
#define I2C_MASTER_SDA_IO  GPIO_NUM_18
#define I2C_MASTER_NUM     I2C_NUM_0
#define I2C_MASTER_FREQ_HZ 100000
#define OLED_I2C_ADDR      0x3C

static adc_oneshot_unit_handle_t s_adc1_handle = NULL;

/* ============== ADC 初始化 ============== */
static void adc_init(void)
{
    adc_oneshot_unit_init_cfg_t init_config = { .unit_id = ADC_UNIT_1 };
    ESP_ERROR_CHECK(adc_oneshot_new_unit(&init_config, &s_adc1_handle));

    adc_oneshot_chan_cfg_t config = {
        .bitwidth = ADC_BITWIDTH_12,
        .atten    = ADC_ATTEN_DB_12,
    };
    /* 配置3个ADC通道 */
    ESP_ERROR_CHECK(adc_oneshot_config_channel(s_adc1_handle, SOIL_ADC_CHANNEL, &config));
    ESP_ERROR_CHECK(adc_oneshot_config_channel(s_adc1_handle, LIGHT_ADC_CHANNEL, &config));
    ESP_ERROR_CHECK(adc_oneshot_config_channel(s_adc1_handle, RAIN_ADC_CHANNEL, &config));
    ESP_LOGI(TAG, "ADC初始化: CH5(雨滴/GPIO33) CH6(土壤/GPIO34) CH7(光照/GPIO35)");
}

static int adc_read_avg(adc_channel_t ch)
{
    int sum = 0;
    for (int i = 0; i < 5; i++) {
        int raw;
        adc_oneshot_read(s_adc1_handle, ch, &raw);
        sum += raw;
        vTaskDelay(pdMS_TO_TICKS(5));
    }
    return sum / 5;
}

/* ============== I2C OLED (SSD1306) ============== */
static esp_err_t oled_write_cmd(uint8_t cmd)
{
    i2c_cmd_handle_t h = i2c_cmd_link_create();
    i2c_master_start(h);
    i2c_master_write_byte(h, (OLED_I2C_ADDR << 1) | I2C_MASTER_WRITE, true);
    i2c_master_write_byte(h, 0x00, true);
    i2c_master_write_byte(h, cmd, true);
    i2c_master_stop(h);
    esp_err_t ret = i2c_master_cmd_begin(I2C_MASTER_NUM, h, pdMS_TO_TICKS(1000));
    i2c_cmd_link_delete(h);
    return ret;
}

static esp_err_t oled_write_data(uint8_t data)
{
    i2c_cmd_handle_t h = i2c_cmd_link_create();
    i2c_master_start(h);
    i2c_master_write_byte(h, (OLED_I2C_ADDR << 1) | I2C_MASTER_WRITE, true);
    i2c_master_write_byte(h, 0x40, true);
    i2c_master_write_byte(h, data, true);
    i2c_master_stop(h);
    esp_err_t ret = i2c_master_cmd_begin(I2C_MASTER_NUM, h, pdMS_TO_TICKS(1000));
    i2c_cmd_link_delete(h);
    return ret;
}

static void oled_clear(void)
{
    for (uint8_t page = 0; page < 8; page++) {
        oled_write_cmd(0xB0 + page);
        oled_write_cmd(0x00);
        oled_write_cmd(0x10);
        for (int col = 0; col < 128; col++)
            oled_write_data(0x00);
    }
}

static const uint8_t font5x8[][5] = {
    {0x00,0x00,0x00,0x00,0x00},{0x00,0x00,0x2f,0x00,0x00},{0x00,0x07,0x00,0x07,0x00},
    {0x14,0x7f,0x14,0x7f,0x14},{0x24,0x2a,0x7f,0x2a,0x12},{0x62,0x64,0x08,0x13,0x23},
    {0x36,0x49,0x55,0x22,0x50},{0x00,0x05,0x03,0x00,0x00},{0x00,0x1c,0x22,0x41,0x00},
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    {0x00,0x41,0x36,0x08,0x00},{0x02,0x01,0x02,0x04,0x02},
};

static void oled_show_text(int line, const char *text)
{
    if (line < 0 || line > 7) return;
    oled_write_cmd(0xB0 + line);
    oled_write_cmd(0x00);
    oled_write_cmd(0x10);
    /* 先用空格填满整行（21字符 × 6列 = 126列），清除旧内容残留 */
    for (int i = 0; i < 21; i++) {
        for (int col = 0; col < 5; col++)
            oled_write_data(0x00);
        oled_write_data(0x00);
    }
    /* 回到行首，写入新内容 */
    oled_write_cmd(0xB0 + line);
    oled_write_cmd(0x00);
    oled_write_cmd(0x10);
    for (int i = 0; text[i] != '\0' && i < 21; i++) {
        char c = text[i];
        if (c < 32 || c > 126) c = ' ';
        uint8_t idx = c - 32;
        for (int col = 0; col < 5; col++)
            oled_write_data(font5x8[idx][col]);
        oled_write_data(0x00);
    }
}

static void oled_init(void)
{
    i2c_config_t conf = {
        .mode = I2C_MODE_MASTER,
        .sda_io_num = I2C_MASTER_SDA_IO,
        .scl_io_num = I2C_MASTER_SCL_IO,
        .sda_pullup_en = GPIO_PULLUP_ENABLE,
        .scl_pullup_en = GPIO_PULLUP_ENABLE,
        .master.clk_speed = I2C_MASTER_FREQ_HZ,
    };
    ESP_ERROR_CHECK(i2c_param_config(I2C_MASTER_NUM, &conf));
    ESP_ERROR_CHECK(i2c_driver_install(I2C_MASTER_NUM, conf.mode, 0, 0, 0));

    const uint8_t cmds[] = {0xAE,0x20,0x00,0x40,0x81,0xCF,0xA1,0xA8,0x3F,
                            0xC8,0xD3,0x00,0xD5,0x80,0xD9,0xF1,0xDA,0x12,
                            0xDB,0x40,0x8D,0x14,0xA4,0xA6,0xAF};
    for (int i = 0; i < sizeof(cmds); i++)
        oled_write_cmd(cmds[i]);
    oled_clear();
    ESP_LOGI(TAG, "OLED初始化: SCL=GPIO19 SDA=GPIO18");
}

/* ============== app_main ============== */
void app_main(void)
{
    ESP_LOGI(TAG, "============================");
    ESP_LOGI(TAG, "实验3B: 智慧农业板 土壤+光照+雨滴+OLED");
    ESP_LOGI(TAG, "学号: %s  姓名: %s", STUDENT_ID, STUDENT_NAME);
    ESP_LOGI(TAG, "============================");

    adc_init();
    oled_init();

    oled_show_text(0, "IoT Smart Farm");
    oled_show_text(1, "Starting...");
    vTaskDelay(pdMS_TO_TICKS(1000));

    int loop = 0;
    while (1) {
        loop++;

        int soil = adc_read_avg(SOIL_ADC_CHANNEL);
        int light = adc_read_avg(LIGHT_ADC_CHANNEL);
        int rain = adc_read_avg(RAIN_ADC_CHANNEL);

        ESP_LOGI(TAG, "--- 采集#%d ---", loop);
        ESP_LOGI(TAG, "土壤湿度: ADC=%d", soil);
        ESP_LOGI(TAG, "光照: ADC=%d", light);
        ESP_LOGI(TAG, "雨滴: ADC=%d", rain);

        char buf[20];

        snprintf(buf, sizeof(buf), "Soil:%d", soil);
        oled_show_text(0, buf);

        snprintf(buf, sizeof(buf), "Light:%d", light);
        oled_show_text(1, buf);

        snprintf(buf, sizeof(buf), "Rain:%d", rain);
        oled_show_text(2, buf);

        snprintf(buf, sizeof(buf), "Loop:%d", loop);
        oled_show_text(3, buf);

        vTaskDelay(pdMS_TO_TICKS(2000));
    }
}
