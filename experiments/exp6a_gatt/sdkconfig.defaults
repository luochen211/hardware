## experiments/exp6b_ble_prov/sdkconfig.defaults
```kconfig
# 启用Bluetooth (Bluedroid - Classic + BLE)
CONFIG_BT_ENABLED=y
CONFIG_BT_BLUEDROID_ENABLED=y
CONFIG_BT_BT_NIMBLE_ENABLED=n
CONFIG_BT_GATTS_ENABLE=y

# WiFi
CONFIG_ESP_WIFI_ENABLED=y
CONFIG_ESP_WIFI_IRAM_OPT=n  # 关闭WiFi IRAM优化，省出IRAM空间

# BLE Provisioning
CONFIG_WIFI_PROVISIONING_ENABLED=y
CONFIG_ESP_PROTOCOMM_SUPPORT_SECURITY_VERSION_0=y

# 自定义分区表（BLE+WiFi+Provisioning固件约1.9MB，需扩大factory分区）
CONFIG_PARTITION_TABLE_CUSTOM=y
CONFIG_PARTITION_TABLE_CUSTOM_FILENAME="partitions.csv"

# Flash大小（实训箱是8MB Flash）
CONFIG_ESPTOOLPY_FLASHSIZE_8MB=y
CONFIG_ESPTOOLPY_FLASHSIZE="8MB"
```

## experiments/exp7_mqtt/sdkconfig.defaults
```kconfig
# Flash大小（实训箱是8MB Flash）
CONFIG_ESPTOOLPY_FLASHSIZE_8MB=y
CONFIG_ESPTOOLPY_FLASHSIZE="8MB"

# 自定义分区表
CONFIG_PARTITION_TABLE_CUSTOM=y
CONFIG_PARTITION_TABLE_CUSTOM_FILENAME="partitions.csv"

# WiFi IRAM优化关闭（省IRAM空间）
CONFIG_ESP_WIFI_IRAM_OPT=n
```

## experiments/exp8a_mqtt/sdkconfig.defaults
```kconfig
# Flash大小
CONFIG_ESPTOOLPY_FLASHSIZE_8MB=y
CONFIG_ESPTOOLPY_FLASHSIZE="8MB"

# 自定义分区表
CONFIG_PARTITION_TABLE_CUSTOM=y
CONFIG_PARTITION_TABLE_CUSTOM_FILENAME="partitions.csv"

# WiFi IRAM优化关闭
CONFIG_ESP_WIFI_IRAM_OPT=n

# 抑制I2C旧驱动EOL警告
CONFIG_I2C_SUPPRESS_DEPRECATE_WARN=y
```
